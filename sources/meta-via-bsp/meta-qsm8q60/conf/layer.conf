## sources/meta-via-bsp/meta-qsm8q60/conf/layer.conf
```bitbake
# We have a conf and classes directory, add to BBPATH
BBPATH .= ":${LAYERDIR}"

# We have recipes-* directories, add to BBFILES
BBFILES += "${LAYERDIR}/recipes-*/*/*.bb \
	${LAYERDIR}/recipes-*/*/*.bbappend"

BBFILE_COLLECTIONS += "qsm8q60"
BBFILE_PATTERN_qsm8q60 = "^${LAYERDIR}/"
BBFILE_PRIORITY_qsm8q60 = "9"
```

## sources/meta-via-bsp/meta-qsm8q60/conf/machine/imx6qsm8q60.conf
```bitbake
#@TYPE: Machine
#@NAME: VIA QSM-8Q60
#@SOC: i.MX6QDL
#@DESCRIPTION: Machine configuration for QSM-8Q60

require conf/machine/include/imx6sabresd-common.inc

SOC_FAMILY = "mx6:mx6dl:mx6q"

KERNEL_DEVICETREE = "imx6q-qsm8q60.dtb imx6dl-qsm8q60.dtb"

KERNEL_IMAGETYPE = "zImage"

UBOOT_CONFIG ??= "sd"
UBOOT_CONFIG[sd] = "mx6qsm8q60_config,sdcard"

MACHINE_ESSENTIAL_EXTRA_RDEPENDS += "exar"

MACHINE_FIRMWARE += "linux-firmware-ath9k"
```
